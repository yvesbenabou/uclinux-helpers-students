## tp/tp3/br2_external/Config.in
```kconfig
menu "TP Kconfig" 

config BR2_KCONFIG_TP
	bool "Activer le TP"

config BR2_KCONFIG_TP_MESSAGE
	string "Message du TP"
	default "Salut depuis le TP de Kconfig"
	depends on BR2_KCONFIG_TP

config BR2_KCONFIG_TP_PREREQUIS
	bool

config BR2_KCONFIG_TP_SUPER_FEATURE
	bool "Active la super feature"
	depends on BR2_KCONFIG_TP
	select BR2_KCONFIG_TP_PREREQUIS

endmenu
```

## tp/tp6/br2_external/Config.in
```kconfig
source "$BR2_EXTERNAL_UCLINUX_TP_PATH/package/my_hello/Config.in"
source "$BR2_EXTERNAL_UCLINUX_TP_PATH/package/fb-test-app-minimal/Config.in"
```

## tp/tp6/br2_external/package/fb-test-app-minimal/Config.in
```kconfig
config BR2_PACKAGE_FB_TEST_APP_MINIMAL
    bool "fb-test-app-minimal"
    select BR2_PACKAGE_FB_TEST_APP
    help
      Install the standard fb-test-app package, but keep only
      /usr/bin/fb-test in the target root filesystem.
```

## tp/tp6/br2_external/package/my_hello/Config.in
```kconfig
config BR2_PACKAGE_MY_HELLO
	bool "my_hello"
	help
	  Petit programme de démonstration
```
